AUTOSAR XML (schema 4-3-1)
package /Interfaces
  sender receiver interface Entrada_Control
    data Entrada_Control: category=VALUE, sw-calibration-access=READ-ONLY, type=Double
  sender receiver interface Salida_Control
    data Salida_Control: category=VALUE, sw-calibration-access=READ-ONLY, type=Double
