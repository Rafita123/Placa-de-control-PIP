AUTOSAR XML (schema 4-3-1)
package /Components/SwcImplementations
  swc implementation contol_Impl: programming-language=C, sw-version=1.7.1, used-code-generator=Embedded Coder 7.6 (R2021a) 14-Nov-2020, vendor-id=0, behavior=contol_IB
    code-descriptors:
      code Code
        artifact-descriptors:
          short-label=contol_c, category=SWSRC
          short-label=contol_h, category=SWHDR
          short-label=rtwtypes_h, category=SWHDR
    resource consumption RsrcCons_contol
